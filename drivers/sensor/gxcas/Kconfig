## drivers/sensor/gxcas/Kconfig
```kconfig
# SPDX-License-Identifier: Apache-2.0

source "drivers/sensor/gxcas/gx21m15/Kconfig"
```

## drivers/sensor/gxcas/gx21m15/Kconfig
```kconfig
# GX21M15 temperature sensor configuration options

# Copyright (c) 2025 Aaron Chan
# SPDX-License-Identifier: Apache-2.0

config GX21M15
	bool "GX21M15 Temperature Sensor"
	default y
	depends on DT_HAS_GXCAS_GX21M15_ENABLED
	select I2C
	help
	  Enable the driver for the GXCAS GX21M15 digital temperature sensor
	  with I2C interface. This driver reads temperature data and provides
	  it through the sensor API.
```

## dts/bindings/sensor/gxcas,gx21m15/gxcas,gx21m15.yaml
```yaml
# Copyright (c) 2025 GXCAS
# SPDX-License-Identifier: Apache-2.0

description: GXCAS GX21M15 temperature sensor

compatible: "gxcas,gx21m15"

include: [sensor-device.yaml, i2c-device.yaml]

properties:
  int-gpios:
    type: phandle-array
    description: |
      Identifies the ALERT/INT pin. This pin is active-low by default.

  int-inverted:
    type: boolean
    description: |
      Sensor's interrupt polarity. If true, the ALERT/INT pin is active-high,
      otherwise it is active-low.
```

## dts/bindings/sensor/meas,ms56xx-i2c.yaml
```yaml
# Copyright (c) 2021, Aurelien Jarno <aurel32@aurel32.net>
# SPDX-License-Identifier: Apache-2.0

description: |
    TE Connectivity MS5607/MS5611 digital pressure and temperature sensor.
    The Datasheet is at https://www.te.com/usa-en/product-CAT-BLPS0035.html

compatible: "meas,ms56xx"

include: [sensor-device.yaml, i2c-device.yaml]

properties:
  chip:
    type: int
    required: true
    description: Chip type (7 for ms5607, 11 for ms5611)
    enum:
      - 7  # MS5607
      - 11 # MS5611
```

## dts/bindings/sensor/meas,ms56xx-spi.yaml
```yaml
# Copyright (c) 2019, Thomas Schmid <tom@lfence.de>
# SPDX-License-Identifier: Apache-2.0

description: |
    TE Connectivity MS5607/MS5611 digital pressure and temperature sensor.
    The Datasheet is at https://www.te.com/usa-en/product-CAT-BLPS0035.html

compatible: "meas,ms56xx"

include: [sensor-device.yaml, spi-device.yaml]

properties:
  chip:
    type: int
    required: true
    description: Chip type (7 for ms5607, 11 for ms5611)
    enum:
      - 7  # MS5607
      - 11 # MS5611
```
